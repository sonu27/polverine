## firmware/sdkconfig.defaults
```kconfig
# Target
CONFIG_IDF_TARGET="esp32s3"

# Flash
CONFIG_ESPTOOLPY_FLASHSIZE_8MB=y

# CPU frequency - 80MHz minimum for WiFi, reduces self-heating
CONFIG_ESP_DEFAULT_CPU_FREQ_MHZ_80=y

# Power management (light sleep disabled - incompatible with USB Serial/JTAG console)
CONFIG_PM_ENABLE=y
CONFIG_PM_DFS_INIT_AUTO=y
# CONFIG_FREERTOS_USE_TICKLESS_IDLE is not set

# WiFi
CONFIG_ESP_WIFI_SOFTAP_SUPPORT=n

# MQTT
CONFIG_MQTT_PROTOCOL_311=y

# USB Serial/JTAG console
CONFIG_ESP_CONSOLE_USB_SERIAL_JTAG=y
CONFIG_ESP_CONSOLE_SECONDARY_NONE=y

# Log level
CONFIG_LOG_DEFAULT_LEVEL_INFO=y

# Stack sizes
CONFIG_ESP_MAIN_TASK_STACK_SIZE=4096

# Partition table - single factory app
CONFIG_PARTITION_TABLE_SINGLE_APP_LARGE=y

# FreeRTOS
CONFIG_FREERTOS_HZ=1000
```
